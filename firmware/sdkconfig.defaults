## firmware/sdkconfig.defaults
```kconfig
CONFIG_BT_ENABLED=y
CONFIG_BT_CONTROLLER_ENABLED=y
CONFIG_BT_NIMBLE_ENABLED=y
CONFIG_BT_NIMBLE_EXT_ADV=y
CONFIG_BT_NIMBLE_MAX_EXT_ADV_INSTANCES=1
CONFIG_BT_NIMBLE_50_FEATURE_SUPPORT=y
CONFIG_BT_CTRL_50_FEATURE_SUPPORT=y
CONFIG_ESP_CONSOLE_NONE=y

# Power Management for Battery Operation
CONFIG_PM_ENABLE=y
CONFIG_FREERTOS_USE_TICKLESS_IDLE=y
CONFIG_PM_DFS_INIT_AUTO=y

# Reduce CPU frequency to save power (80 MHz instead of 240 MHz)
CONFIG_ESP_DEFAULT_CPU_FREQ_MHZ_80=y
CONFIG_ESP_DEFAULT_CPU_FREQ_MHZ=80

# WiFi power saving - modem sleep when idle
CONFIG_ESP_WIFI_STA_DISCONNECTED_PM_ENABLE=y
```
